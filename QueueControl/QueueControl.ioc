# file: QueueControl.ioc
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FREERTOS.Queues01=myQueue01,4,uint16_t,0,Dynamic,NULL,NULL
FREERTOS.Tasks01=defaultTask,0,128,StartDefaultTask,Default,NULL,Dynamic,NULL,NULL;myTask01,0,128,StartTask01,Default,NULL,Dynamic,NULL,NULL;myTask02,0,128,StartTask02,Default,NULL,Dynamic,NULL,NULL;myTask03,1,128,StartTask03,Default,NULL,Dynamic,NULL,NULL;myTask04,1,128,StartTask04,Default,NULL,Dynamic,NULL,NULL
FREERTOS.configUSE_APPLICATION_TASK_TAG=1
Mcu.Family=STM32F4
Mcu.Name=STM32F401R(B-C)Tx
Mcu.Package=LQFP64
NVIC.PriorityGroup=NVIC_PRIORITYGROUP_4
ProjectManager.HeapSize=0x200
ProjectManager.StackSize=0x400
ProjectManager.TargetToolchain=MDK-ARM V5.32
RCC.AHBFreq_Value=16000000
RCC.APB1Freq_Value=16000000
RCC.APB2Freq_Value=16000000
RCC.CortexFreq_Value=16000000
RCC.HSE_VALUE=25000000
RCC.HSI_VALUE=16000000
RCC.LSE_VALUE=32768
RCC.SYSCLKFreq_VALUE=16000000
RCC.VCOOutputFreq_Value=192000000
VP_FREERTOS_VS_CMSIS_V1.Mode=CMSIS_V1
board=custom

// file: Core/Src/main.c
/* USER CODE BEGIN Header */
/**
  ******************************************************************************
  * @file           : main.c
  * @brief          : Main program body
  ******************************************************************************
  * @attention
  *
  * Copyright (c) 2026 STMicroelectronics.
  * All rights reserved.
  *
  * This software is licensed under terms that can be found in the LICENSE file
  * in the root directory of this software component.
  * If no LICENSE file comes with this software, it is provided AS-IS.
  *
  ******************************************************************************
  */
/* USER CODE END Header */
#include "main.h"
#include "cmsis_os.h"

osThreadId defaultTaskHandle;
osThreadId myTask01Handle;
osThreadId myTask02Handle;
osThreadId myTask03Handle;
osThreadId myTask04Handle;
osMessageQId myQueue01Handle;

void SystemClock_Config(void);
void StartDefaultTask(void const * argument);
void StartTask01(void const * argument);
void StartTask02(void const * argument);
void StartTask03(void const * argument);
void StartTask04(void const * argument);

int main(void)
{

  /* MCU Configuration--------------------------------------------------------*/

  /* Reset of all peripherals, Initializes the Flash interface and the Systick. */
  LL_APB2_GRP1_EnableClock(LL_APB2_GRP1_PERIPH_SYSCFG);
  LL_APB1_GRP1_EnableClock(LL_APB1_GRP1_PERIPH_PWR);

  /* System interrupt init*/
  NVIC_SetPriorityGrouping(NVIC_PRIORITYGROUP_4);

  /* PendSV_IRQn interrupt configuration */
  NVIC_SetPriority(PendSV_IRQn, NVIC_EncodePriority(NVIC_GetPriorityGrouping(),15, 0));
  /* SysTick_IRQn interrupt configuration */
  NVIC_SetPriority(SysTick_IRQn, NVIC_EncodePriority(NVIC_GetPriorityGrouping(),15, 0));

  /* Configure the system clock */
  SystemClock_Config();

  /* Initialize all configured peripherals */

  /* Create the queue(s) */
  /* definition and creation of myQueue01 */
  osMessageQDef(myQueue01, 4, uint16_t);
  myQueue01Handle = osMessageCreate(osMessageQ(myQueue01), NULL);

  /* Create the thread(s) */
  /* definition and creation of defaultTask */
  osThreadDef(defaultTask, StartDefaultTask, osPriorityNormal, 0, 128);
  defaultTaskHandle = osThreadCreate(osThread(defaultTask), NULL);

  /* definition and creation of myTask01 */
  osThreadDef(myTask01, StartTask01, osPriorityNormal, 0, 128);
  myTask01Handle = osThreadCreate(osThread(myTask01), NULL);

  /* definition and creation of myTask02 */
  osThreadDef(myTask02, StartTask02, osPriorityNormal, 0, 128);
  myTask02Handle = osThreadCreate(osThread(myTask02), NULL);

  /* definition and creation of myTask03 */
  osThreadDef(myTask03, StartTask03, osPriorityNormal, 0, 128);
  myTask03Handle = osThreadCreate(osThread(myTask03), NULL);

  /* definition and creation of myTask04 */
  osThreadDef(myTask04, StartTask04, osPriorityNormal, 0, 128);
  myTask04Handle = osThreadCreate(osThread(myTask04), NULL);

  /* Start scheduler */
  osKernelStart();

  /* We should never get here as control is now taken by the scheduler */

  /* Infinite loop */
  while (1)
  {

  }
}

void SystemClock_Config(void)
{
  LL_FLASH_SetLatency(LL_FLASH_LATENCY_0);
  while(LL_FLASH_GetLatency()!= LL_FLASH_LATENCY_0)
  {
  }
  LL_PWR_SetRegulVoltageScaling(LL_PWR_REGU_VOLTAGE_SCALE2);
  LL_RCC_HSI_SetCalibTrimming(16);
  LL_RCC_HSI_Enable();

   /* Wait till HSI is ready */
  while(LL_RCC_HSI_IsReady() != 1)
  {

  }
  LL_RCC_SetAHBPrescaler(LL_RCC_SYSCLK_DIV_1);
  LL_RCC_SetAPB1Prescaler(LL_RCC_APB1_DIV_1);
  LL_RCC_SetAPB2Prescaler(LL_RCC_APB2_DIV_1);
  LL_RCC_SetSysClkSource(LL_RCC_SYS_CLKSOURCE_HSI);

   /* Wait till System clock is ready */
  while(LL_RCC_GetSysClkSource() != LL_RCC_SYS_CLKSOURCE_STATUS_HSI)
  {

  }
  LL_Init1msTick(16000000);
  LL_SetSystemCoreClock(16000000);
  LL_RCC_SetTIMPrescaler(LL_RCC_TIM_PRESCALER_TWICE);
}

/* USER CODE BEGIN 4 */
void TaskSwitchedIn(int tag)
{
	switch (tag)
	{
		case 1:
			LL_GPIO_SetOutputPin(GPIOA, LL_GPIO_PIN_0);
			break;
		case 2:
			LL_GPIO_SetOutputPin(GPIOA, LL_GPIO_PIN_1);
			break;
		case 3:
			LL_GPIO_SetOutputPin(GPIOA, LL_GPIO_PIN_2);
			break;
		case 4:
			LL_GPIO_SetOutputPin(GPIOA, LL_GPIO_PIN_3);
			break;
	}
}

void TaskSwitchedOut(int tag)
{
	switch (tag)
	{
		case 1:
			LL_GPIO_ResetOutputPin(GPIOA, LL_GPIO_PIN_0);
			break;
		case 2:
			LL_GPIO_ResetOutputPin(GPIOA, LL_GPIO_PIN_1);
			break;
		case 3:
			LL_GPIO_ResetOutputPin(GPIOA, LL_GPIO_PIN_2);
			break;
		case 4:
			LL_GPIO_ResetOutputPin(GPIOA, LL_GPIO_PIN_3);
			break;
	}
}

void vApplicationIdleHook(void)
{
	LL_GPIO_SetOutputPin(GPIOA, LL_GPIO_PIN_4);
	__NOP();
	LL_GPIO_ResetOutputPin(GPIOA, LL_GPIO_PIN_4);
}
/* USER CODE END 4 */

void StartDefaultTask(void const * argument)
{
  for(;;)
  {
    osDelay(1);
  }
}

void StartTask01(void const * argument)
{
  /* USER CODE BEGIN StartTask01 */
	vTaskSetApplicationTaskTag(NULL,(void*)1);
	uint32_t Item = 1;
  /* Infinite loop */
  for(;;)
  {
		xQueueSend(myQueue01Handle, &Item, portMAX_DELAY);
  }
  /* USER CODE END StartTask01 */
}

void StartTask02(void const * argument)
{
  /* USER CODE BEGIN StartTask02 */
	vTaskSetApplicationTaskTag(NULL,(void*)2);
	uint32_t Item = 2;
  /* Infinite loop */
  for(;;)
  {
		xQueueSend(myQueue01Handle, &Item, portMAX_DELAY);
  }
  /* USER CODE END StartTask02 */
}

void StartTask03(void const * argument)
{
  /* USER CODE BEGIN StartTask03 */
	vTaskSetApplicationTaskTag(NULL,(void*)3);
	uint32_t Item = 10;
  /* Infinite loop */
  for(;;)
  {
		xQueueSend(myQueue01Handle, &Item, portMAX_DELAY);
  }
  /* USER CODE END StartTask03 */
}

void StartTask04(void const * argument)
{
  /* USER CODE BEGIN StartTask04 */
	vTaskSetApplicationTaskTag(NULL,(void*)4);
	uint32_t Receive;
  /* Infinite loop */
  for(;;)
  {
		xQueueReceive(myQueue01Handle,&Receive,portMAX_DELAY);
		osDelay(1);
  }
  /* USER CODE END StartTask04 */
}

void Error_Handler(void)
{
  __disable_irq();
  while (1)
  {
  }
}
